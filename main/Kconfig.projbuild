## main/Kconfig.projbuild
```kconfig
menu "ESP32-S3-CAM Telegram Configuration"

    menu "WiFi Configuration"
        config WIFI_SSID
            string "WiFi SSID"
            default "YourWiFiSSID"
            help
                WiFi SSID (network name) to connect to.

        config WIFI_PASSWORD
            string "WiFi Password"
            default "YourWiFiPassword"
            help
                WiFi password (WPA or WPA2).
    endmenu

    menu "Telegram Bot Configuration"
        config TELEGRAM_BOT_TOKEN
            string "Telegram Bot Token"
            default "YOUR_BOT_TOKEN_HERE"
            help
                Telegram Bot API Token from BotFather.

        config TELEGRAM_CHAT_ID
            string "Telegram Chat ID"
            default "YOUR_CHAT_ID_HERE"
            help
                Target Telegram Chat ID to send messages to.
    endmenu

    menu "Detection Configuration"
        config ENABLE_FACE_DETECTION
            bool "Enable Face Detection"
            default y
            help
                Enable face detection feature.

        config ENABLE_MOTION_DETECTION
            bool "Enable Motion Detection"
            default y
            help
                Enable motion detection feature.

        config MOTION_THRESHOLD
            int "Motion Detection Threshold"
            default 15
            range 5 50
            help
                Threshold for motion detection sensitivity (lower = more sensitive).

        config MOTION_PIXEL_THRESHOLD
            int "Motion Pixel Threshold Percentage"
            default 5
            range 1 50
            help
                Percentage of changed pixels to trigger motion detection.

        config DETECTION_INTERVAL_MS
            int "Detection Interval (ms)"
            default 500
            range 100 5000
            help
                Interval between detection checks in milliseconds.

        config TELEGRAM_COOLDOWN_SEC
            int "Telegram Notification Cooldown (seconds)"
            default 10
            range 5 300
            help
                Minimum time between Telegram notifications to avoid spam.
    endmenu

    menu "Camera Configuration"
        choice CAMERA_MODULE
            prompt "Select Camera Module"
            default CAMERA_MODULE_ESP32S3_CAM
            help
                Select the camera module you are using.

            config CAMERA_MODULE_ESP32S3_CAM
                bool "ESP32-S3-CAM (FREENOVE/Generic)"
            config CAMERA_MODULE_ESP32S3_EYE
                bool "ESP32-S3-EYE (Espressif)"
            config CAMERA_MODULE_XIAO_ESP32S3
                bool "Seeed XIAO ESP32S3 Sense"
        endchoice
    endmenu

endmenu
```

## sdkconfig.defaults
```kconfig
# ESP32-S3 specific settings
CONFIG_IDF_TARGET="esp32s3"

# PSRAM settings for ESP32-S3
CONFIG_SPIRAM=y
CONFIG_SPIRAM_MODE_OCT=y
CONFIG_SPIRAM_SPEED_80M=y
CONFIG_SPIRAM_BOOT_INIT=y
CONFIG_SPIRAM_USE_MALLOC=y
CONFIG_SPIRAM_MALLOC_ALWAYSINTERNAL=4096
CONFIG_SPIRAM_MALLOC_RESERVE_INTERNAL=32768

# Camera settings
CONFIG_CAMERA_TASK_PINNED_TO_CORE_1=y
CONFIG_CAMERA_CORE1=y

# WiFi settings
CONFIG_ESP_WIFI_STATIC_RX_BUFFER_NUM=16
CONFIG_ESP_WIFI_DYNAMIC_RX_BUFFER_NUM=64
CONFIG_ESP_WIFI_DYNAMIC_TX_BUFFER_NUM=64
CONFIG_ESP_WIFI_TX_BUFFER_TYPE=1
CONFIG_ESP_WIFI_RX_BA_WIN=32
CONFIG_ESP_WIFI_IRAM_OPT=y
CONFIG_ESP_WIFI_RX_IRAM_OPT=y

# HTTP Client
CONFIG_ESP_HTTP_CLIENT_ENABLE_HTTPS=y
CONFIG_ESP_HTTP_CLIENT_ENABLE_BASIC_AUTH=n

# TLS/SSL
CONFIG_MBEDTLS_SSL_MAX_CONTENT_LEN=16384
CONFIG_MBEDTLS_CERTIFICATE_BUNDLE=y
CONFIG_MBEDTLS_CERTIFICATE_BUNDLE_DEFAULT_FULL=y

# Task Watchdog
CONFIG_ESP_TASK_WDT_TIMEOUT_S=30

# FreeRTOS
CONFIG_FREERTOS_HZ=1000
CONFIG_FREERTOS_UNICORE=n

# Partition Table
CONFIG_PARTITION_TABLE_CUSTOM=y
CONFIG_PARTITION_TABLE_CUSTOM_FILENAME="partitions.csv"

# Log level
CONFIG_LOG_DEFAULT_LEVEL_INFO=y
CONFIG_LOG_DEFAULT_LEVEL=3

# Flash size
CONFIG_ESPTOOLPY_FLASHSIZE_4MB=y
CONFIG_ESPTOOLPY_FLASHSIZE="4MB"

# Bootloader
CONFIG_BOOTLOADER_LOG_LEVEL_WARN=y

# Power Management disabled for stability
CONFIG_PM_ENABLE=n
```
